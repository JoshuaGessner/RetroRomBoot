## buildroot/Config.in
```kconfig
menu "RomBoot options"

config BR2_PACKAGE_ROMBOOT_RUNTIME
	bool "RomBoot appliance runtime"
	default y
	help
	  Installs the read-only, one-game runtime overlay used by RomBoot targets.

source "$BR2_EXTERNAL_ROMBOOT_PATH/package/romboot-retroarch/Config.in"
source "$BR2_EXTERNAL_ROMBOOT_PATH/package/romboot-libretro-fceumm/Config.in"
source "$BR2_EXTERNAL_ROMBOOT_PATH/package/romboot-joypad-autoconfig/Config.in"
source "$BR2_EXTERNAL_ROMBOOT_PATH/package/romboot-libretro-snes9x2010/Config.in"
source "$BR2_EXTERNAL_ROMBOOT_PATH/package/romboot-libretro-genesis-plus-gx/Config.in"
source "$BR2_EXTERNAL_ROMBOOT_PATH/package/romboot-libretro-gambatte/Config.in"
source "$BR2_EXTERNAL_ROMBOOT_PATH/package/romboot-libretro-mgba/Config.in"
source "$BR2_EXTERNAL_ROMBOOT_PATH/package/romboot-libretro-beetle-pce-fast/Config.in"
endmenu
```

## buildroot/package/romboot-joypad-autoconfig/Config.in
```kconfig
config BR2_PACKAGE_ROMBOOT_JOYPAD_AUTOCONFIG
	bool "RetroArch joypad autoconfig profiles (udev)"
	help
	  Bundles RetroArch's joypad autoconfiguration profiles so USB
	  controllers are mapped automatically by vendor/product id, without
	  a per-device binding in retroarch.cfg.

	  https://github.com/libretro/retroarch-joypad-autoconfig
```

## buildroot/package/romboot-libretro-beetle-pce-fast/Config.in
```kconfig
config BR2_PACKAGE_ROMBOOT_LIBRETRO_BEETLE_PCE_FAST
	bool "Beetle PCE Fast libretro core (RomBoot pinned build)"
	depends on BR2_TOOLCHAIN_HAS_THREADS
	depends on BR2_INSTALL_LIBSTDCPP
	help
	  Beetle PCE Fast (Mednafen) PC Engine / TurboGrafx-16 core (libretro).

	  https://github.com/libretro/beetle-pce-fast-libretro
```

## buildroot/package/romboot-libretro-fceumm/Config.in
```kconfig
config BR2_PACKAGE_ROMBOOT_LIBRETRO_FCEUMM
	bool "FCEUmm libretro core (RomBoot pinned build)"
	depends on BR2_TOOLCHAIN_HAS_THREADS
	help
	  FCEUmm NES/Famicom emulator core for the libretro API.

	  https://github.com/libretro/libretro-fceumm
```

## buildroot/package/romboot-libretro-gambatte/Config.in
```kconfig
config BR2_PACKAGE_ROMBOOT_LIBRETRO_GAMBATTE
	bool "Gambatte libretro core (RomBoot pinned build)"
	depends on BR2_TOOLCHAIN_HAS_THREADS
	depends on BR2_INSTALL_LIBSTDCPP
	help
	  Gambatte Game Boy / Game Boy Color emulator core (libretro).

	  https://github.com/libretro/gambatte-libretro
```

## buildroot/package/romboot-libretro-genesis-plus-gx/Config.in
```kconfig
config BR2_PACKAGE_ROMBOOT_LIBRETRO_GENESIS_PLUS_GX
	bool "Genesis Plus GX libretro core (RomBoot pinned build)"
	depends on BR2_TOOLCHAIN_HAS_THREADS
	help
	  Genesis Plus GX core (libretro): Sega Genesis/Mega Drive, Master
	  System, Game Gear, SG-1000.

	  https://github.com/libretro/Genesis-Plus-GX
```

## buildroot/package/romboot-libretro-mgba/Config.in
```kconfig
config BR2_PACKAGE_ROMBOOT_LIBRETRO_MGBA
	bool "mGBA libretro core (RomBoot pinned build)"
	depends on BR2_TOOLCHAIN_HAS_THREADS
	help
	  mGBA Game Boy Advance emulator core (libretro).

	  https://github.com/libretro/mgba
```

## buildroot/package/romboot-libretro-snes9x2010/Config.in
```kconfig
config BR2_PACKAGE_ROMBOOT_LIBRETRO_SNES9X2010
	bool "Snes9x 2010 libretro core (RomBoot pinned build)"
	depends on BR2_TOOLCHAIN_HAS_THREADS
	help
	  Snes9x 2010 SNES/Super Famicom emulator core (libretro).

	  https://github.com/libretro/snes9x2010
```

## buildroot/package/romboot-retroarch/Config.in
```kconfig
config BR2_PACKAGE_ROMBOOT_RETROARCH
	bool "RetroArch (RomBoot pinned build)"
	depends on BR2_USE_MMU
	depends on BR2_TOOLCHAIN_HAS_THREADS
	depends on BR2_PACKAGE_HAS_LIBEGL
	depends on BR2_PACKAGE_HAS_LIBGLES
	select BR2_PACKAGE_ALSA_LIB
	select BR2_PACKAGE_LIBDRM
	select BR2_PACKAGE_ZLIB
	help
	  Minimal RetroArch frontend configured for direct DRM/KMS, EGL/GLES,
	  ALSA, and udev input. Network, desktop-window-system, and updater
	  features are disabled for the RomBoot appliance.

	  https://www.retroarch.com/
```
